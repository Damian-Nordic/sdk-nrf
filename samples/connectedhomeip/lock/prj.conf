## CMakeLists.txt
```
#
# Copyright (c) 2020 Nordic Semiconductor ASA
#
# SPDX-License-Identifier: LicenseRef-BSD-5-Clause-Nordic
#

cmake_minimum_required(VERSION 3.13.1)

get_filename_component(CHIP_ROOT ../../../../modules/lib/connectedhomeip REALPATH)
get_filename_component(COMMON_ROOT ../common REALPATH)

include(${CHIP_ROOT}/config/nrfconnect/app/app.cmake)

project(chip-lock)

target_include_directories(app PRIVATE src ${COMMON_ROOT}/src)

target_sources(app PRIVATE
               src/AppTask.cpp
               src/BoltLockManager.cpp
               src/gen/call-command-handler.cpp
               src/gen/callback-stub.cpp
               src/main.cpp
               src/server/DataModelHandler.cpp
               src/server/QRCodeUtil.cpp
               src/server/RendezvousServer.cpp
               src/server/Server.cpp
               src/server/ZclCallbacks.cpp
               ${COMMON_ROOT}/src/LEDWidget.cpp
               ${COMMON_ROOT}/src/NFCWidget.cpp
               ${COMMON_ROOT}/src/ThreadUtil.cpp
               ${CHIP_ROOT}/src/app/reporting/reporting-default-configuration.cpp
               ${CHIP_ROOT}/src/app/reporting/reporting.cpp
               ${CHIP_ROOT}/src/app/util/af-event.cpp
               ${CHIP_ROOT}/src/app/util/af-main-common.cpp
               ${CHIP_ROOT}/src/app/util/attribute-size.cpp
               ${CHIP_ROOT}/src/app/util/attribute-storage.cpp
               ${CHIP_ROOT}/src/app/util/attribute-table.cpp
               ${CHIP_ROOT}/src/app/util/binding-table.cpp
               ${CHIP_ROOT}/src/app/util/chip-message-send.cpp
               ${CHIP_ROOT}/src/app/util/client-api.cpp
               ${CHIP_ROOT}/src/app/util/ember-print.cpp
               ${CHIP_ROOT}/src/app/util/message.cpp
               ${CHIP_ROOT}/src/app/util/process-cluster-message.cpp
               ${CHIP_ROOT}/src/app/util/process-global-message.cpp
               ${CHIP_ROOT}/src/app/util/util.cpp
               ${CHIP_ROOT}/src/app/clusters/on-off-server/on-off.cpp)
```

## prj.conf
```kconfig
#
# Copyright (c) 2020 Nordic Semiconductor ASA
#
# SPDX-License-Identifier: LicenseRef-BSD-5-Clause-Nordic
#

# Enable CHIP
CONFIG_CHIP=y
CONFIG_CHIP_PROJECT_CONFIG="src/CHIPProjectConfig.h"
CONFIG_STD_CPP14=y

# General networking settings
CONFIG_NETWORKING=y
CONFIG_NET_IPV6_NBR_CACHE=n
CONFIG_NET_IPV6_MLD=n

# Enable OpenThread MTD
CONFIG_NET_L2_OPENTHREAD=y

CONFIG_OPENTHREAD_MTD=y
CONFIG_OPENTHREAD_FTD=n
CONFIG_OPENTHREAD_SLAAC=y
CONFIG_OPENTHREAD_MTD_NETDIAG=y
CONFIG_OPENTHREAD_MANUAL_START=y
CONFIG_OPENTHREAD_THREAD_STACK_SIZE=6144

CONFIG_OPENTHREAD_PANID=4660
CONFIG_OPENTHREAD_CHANNEL=15
CONFIG_OPENTHREAD_NETWORK_NAME="OpenThread"
CONFIG_OPENTHREAD_XPANID="11:11:11:11:22:22:22:22"

# Enable Bluetooth Low Energy
CONFIG_BT=y
CONFIG_BT_PERIPHERAL=y
CONFIG_BT_DEVICE_NAME_DYNAMIC=y
CONFIG_BT_DEVICE_NAME_MAX=15
CONFIG_BT_DEVICE_NAME="ChipLock"

# Use NFC to share commissioning information
CONFIG_CHIP_NFC_COMMISSIONING=y

# Use nrf_security
CONFIG_NORDIC_SECURITY_BACKEND=y
CONFIG_OPENTHREAD_MBEDTLS=n

CONFIG_MBEDTLS_ENABLE_HEAP=y
CONFIG_MBEDTLS_HEAP_SIZE=15360
CONFIG_MBEDTLS_TLS_LIBRARY=y
CONFIG_NRF_SECURITY_ADVANCED=y

CONFIG_MBEDTLS_AES_C=y
CONFIG_MBEDTLS_RSA_C=y
CONFIG_MBEDTLS_ECP_C=y
CONFIG_MBEDTLS_ECP_DP_SECP256R1_ENABLED=y
CONFIG_MBEDTLS_CTR_DRBG_C=y
CONFIG_MBEDTLS_CIPHER_MODE_CTR=y
CONFIG_MBEDTLS_ECJPAKE_C=y

# Disable unneeded crypto operations
CONFIG_MBEDTLS_SHA512_C=n
CONFIG_MBEDTLS_CIPHER_MODE_XTS=n
CONFIG_MBEDTLS_CHACHA20_C=n
CONFIG_MBEDTLS_POLY1305_C=n
CONFIG_MBEDTLS_CHACHAPOLY_C=n
CONFIG_MBEDTLS_GCM_C=n

# Add support for LEDs and buttons on Nordic development kits
CONFIG_DK_LIBRARY=y

# Other settings
CONFIG_LOG=y
CONFIG_LOG_MINIMAL=y
CONFIG_MAIN_STACK_SIZE=8192
CONFIG_INIT_STACKS=y
CONFIG_THREAD_NAME=y
CONFIG_MPU_STACK_GUARD=y
```

## src/main.cpp
```c
/*
 * Copyright (c) 2020 Nordic Semiconductor ASA
 *
 * SPDX-License-Identifier: LicenseRef-BSD-5-Clause-Nordic
 */

#include "AppTask.h"

#include <logging/log.h>

#include <platform/CHIPDeviceLayer.h>
#include <support/CHIPMem.h>

LOG_MODULE_REGISTER(app);

using namespace ::chip::DeviceLayer;

int main()
{
	int ret = chip::Platform::MemoryInit();

	if (ret != CHIP_NO_ERROR) {
		LOG_ERR("Platform::MemoryInit() failed");
		return ret;
	}

	ret = PlatformMgr().InitChipStack();
	if (ret != CHIP_NO_ERROR) {
		LOG_ERR("PlatformMgr().InitChipStack() failed");
		return ret;
	}

	ret = ThreadStackMgr().InitThreadStack();
	if (ret != CHIP_NO_ERROR) {
		LOG_ERR("ThreadStackMgr().InitThreadStack() failed");
		return ret;
	}

	ret = PlatformMgr().StartEventLoopTask();
	if (ret != CHIP_NO_ERROR) {
		LOG_ERR("PlatformMgr().StartEventLoopTask() failed");
		return ret;
	}

	return GetAppTask().StartApp();
}
```

## src/AppEvent.h
```c
/*
 * Copyright (c) 2020 Nordic Semiconductor ASA
 *
 * SPDX-License-Identifier: LicenseRef-BSD-5-Clause-Nordic
 */

#pragma once

#include <cstdint>

struct AppEvent {
	enum LockEventType : uint8_t { Lock, Unlock, Toggle, CompleteLockAction };

	enum OtherEventType : uint8_t { FactoryReset = CompleteLockAction + 1, StartThread, StartBleAdvertising };

	AppEvent() = default;
	AppEvent(LockEventType type, bool chipInitiated) : Type(type), LockEvent{ chipInitiated } {}
	explicit AppEvent(OtherEventType type) : Type(type) {}

	uint8_t Type;

	union {
		struct {
			// was the event triggered by CHIP Data Model layer
			bool ChipInitiated;
		} LockEvent;
	};
};
```

## src/AppTask.cpp
```c
/*
 * Copyright (c) 2020 Nordic Semiconductor ASA
 *
 * SPDX-License-Identifier: LicenseRef-BSD-5-Clause-Nordic
 */

#include "AppTask.h"

#include "BoltLockManager.h"
#include "LEDWidget.h"
#include "ThreadUtil.h"

#ifdef CONFIG_CHIP_NFC_COMMISSIONING
#include "NFCWidget.h"
#endif

#include "attribute-storage.h"
#include "gen/cluster-id.h"

#include <platform/CHIPDeviceLayer.h>

#include <app/server/QRCodeUtil.h>
#include <app/server/Server.h>
#include <dk_buttons_and_leds.h>
#include <logging/log.h>
#include <zephyr.h>

using namespace ::chip::DeviceLayer;

LOG_MODULE_DECLARE(app);

namespace
{
static constexpr size_t kAppEventQueueSize = 10;

K_MSGQ_DEFINE(sAppEventQueue, sizeof(AppEvent), kAppEventQueueSize, alignof(AppEvent));
LEDWidget sStatusLED;
LEDWidget sLockLED;

#ifdef CONFIG_CHIP_NFC_COMMISSIONING
NFCWidget sNFC;
#endif

bool sIsThreadProvisioned;
bool sIsThreadEnabled;
bool sIsThreadAttached;
bool sIsPairedToAccount;
bool sHaveBLEConnections;
bool sHaveServiceConnectivity;
} // namespace

AppTask AppTask::sAppTask;

int AppTask::Init()
{
	// Initialize LEDs
	LEDWidget::InitGpio();

	sStatusLED.Init(DK_LED1);
	sLockLED.Init(DK_LED2);
	sLockLED.Set(!BoltLockMgr().IsUnlocked());

	// Initialize buttons
	int ret = dk_buttons_init(ButtonEventHandler);
	if (ret) {
		LOG_ERR("dk_buttons_init() failed");
		return ret;
	}

	// Initialize lock manager
	BoltLockMgr().Init();

	// Init ZCL Data Model and start server
	InitServer();
	PrintQRCode(chip::RendezvousInformationFlags::kBLE);

#ifdef CONFIG_CHIP_NFC_COMMISSIONING
	ret = sNFC.Init(ConnectivityMgr());
	if (ret) {
		LOG_ERR("NFC initialization failed");
		return ret;
	}

	PlatformMgr().AddEventHandler(AppTask::ThreadProvisioningHandler, 0);
#endif

	return 0;
}

int AppTask::StartApp()
{
	int ret = Init();

	if (ret) {
		LOG_ERR("AppTask.Init() failed");
		return ret;
	}

	AppEvent event = {};

	while (true) {
		ret = k_msgq_get(&sAppEventQueue, &event, K_MSEC(10));

		while (!ret) {
			DispatchEvent(event);
			ret = k_msgq_get(&sAppEventQueue, &event, K_NO_WAIT);
		}

		// Collect connectivity and configuration state from the CHIP stack.  Because the
		// CHIP event loop is being run in a separate task, the stack must be locked
		// while these values are queried.  However we use a non-blocking lock request
		// (TryLockChipStack()) to avoid blocking other UI activities when the CHIP
		// task is busy (e.g. with a long crypto operation).

		if (PlatformMgr().TryLockChipStack()) {
			sIsThreadProvisioned = ConnectivityMgr().IsThreadProvisioned();
			sIsThreadEnabled = ConnectivityMgr().IsThreadEnabled();
			sIsThreadAttached = ConnectivityMgr().IsThreadAttached();
			sHaveBLEConnections = (ConnectivityMgr().NumBLEConnections() != 0);
			sHaveServiceConnectivity = ConnectivityMgr().HaveServiceConnectivity();
			PlatformMgr().UnlockChipStack();
		}

		// Consider the system to be "fully connected" if it has service
		// connectivity and it is able to interact with the service on a regular basis.
		bool isFullyConnected = sHaveServiceConnectivity;

		// Update the status LED.
		//
		// If system has "full connectivity", keep the LED On constantly.
		//
		// If thread and service provisioned, but not attached to the thread network yet OR no
		// connectivity to the service OR subscriptions are not fully established
		// THEN blink the LED Off for a short period of time.
		//
		// If the system has ble connection(s) uptill the stage above, THEN blink the LEDs at an even
		// rate of 100ms.
		//
		// Otherwise, blink the LED ON for a very short time.
		if (isFullyConnected) {
			sStatusLED.Set(true);
		} else if (sIsThreadProvisioned && sIsThreadEnabled && sIsPairedToAccount) {
			sStatusLED.Blink(950, 50);
		} else if (sHaveBLEConnections) {
			sStatusLED.Blink(100, 100);
		} else {
			sStatusLED.Blink(50, 950);
		}

		sStatusLED.Animate();
		sLockLED.Animate();
	}
}

void AppTask::PostEvent(const AppEvent &aEvent)
{
	if (k_msgq_put(&sAppEventQueue, &aEvent, K_NO_WAIT)) {
		LOG_INF("Failed to post event to app task event queue");
	}
}

void AppTask::UpdateClusterState()
{
	uint8_t newValue = !BoltLockMgr().IsUnlocked();

	// write the new on/off value
	EmberAfStatus status = emberAfWriteAttribute(1, ZCL_ON_OFF_CLUSTER_ID, ZCL_ON_OFF_ATTRIBUTE_ID,
						     CLUSTER_MASK_SERVER, &newValue, ZCL_BOOLEAN_ATTRIBUTE_TYPE);

	if (status != EMBER_ZCL_STATUS_SUCCESS) {
		LOG_ERR("Updating on/off cluster failed: %x", status);
	}
}

void AppTask::DispatchEvent(const AppEvent &aEvent)
{
	switch (aEvent.Type) {
	case AppEvent::Lock:
		LockActionHandler(BoltLockManager::Action::Lock, aEvent.LockEvent.ChipInitiated);
		break;
	case AppEvent::Unlock:
		LockActionHandler(BoltLockManager::Action::Unlock, aEvent.LockEvent.ChipInitiated);
		break;
	case AppEvent::Toggle:
		LockActionHandler(BoltLockMgr().IsUnlocked() ? BoltLockManager::Action::Lock :
							       BoltLockManager::Action::Unlock,
				  aEvent.LockEvent.ChipInitiated);
		break;
	case AppEvent::CompleteLockAction:
		CompleteLockActionHandler();
		break;
	case AppEvent::FactoryReset:
		LOG_INF("Factory Reset triggered");
		ConfigurationMgr().InitiateFactoryReset();
		break;
	case AppEvent::StartThread:
		StartThreadHandler();
		break;
	case AppEvent::StartBleAdvertising:
		StartBLEAdvertisingHandler();
		break;
	default:
		LOG_INF("Unknown event received");
		break;
	}
}

void AppTask::LockActionHandler(BoltLockManager::Action action, bool chipInitiated)
{
	if (BoltLockMgr().InitiateAction(action, chipInitiated)) {
		sLockLED.Blink(50, 50);
	}
}

void AppTask::CompleteLockActionHandler()
{
	bool chipInitiatedAction;

	if (!BoltLockMgr().CompleteCurrentAction(chipInitiatedAction)) {
		return;
	}

	sLockLED.Set(!BoltLockMgr().IsUnlocked());

	// If the action wasn't initiated by CHIP, update CHIP clusters with the new lock state
	if (!chipInitiatedAction) {
		UpdateClusterState();
	}
}

void AppTask::StartThreadHandler()
{
	if (!ConnectivityMgr().IsThreadProvisioned()) {
		StartDefaultThreadNetwork();
		LOG_INF("Device is not commissioned to a Thread network. Starting with the default configuration");
	} else {
		LOG_INF("Device is commissioned to a Thread network");
	}
}

void AppTask::StartBLEAdvertisingHandler()
{
	if (!sNFC.IsTagEmulationStarted()) {
		if (!(StartNFCTag() < 0)) {
			LOG_INF("Started NFC Tag emulation");
		} else {
			LOG_ERR("Starting NFC Tag failed");
		}
	} else {
		LOG_INF("NFC Tag emulation is already started");
	}

	if (!ConnectivityMgr().IsBLEAdvertisingEnabled()) {
		ConnectivityMgr().SetBLEAdvertisingEnabled(true);
		LOG_INF("Enabled BLE Advertising");
	} else {
		LOG_INF("BLE Advertising is already enabled");
	}
}

#ifdef CONFIG_CHIP_NFC_COMMISSIONING
int AppTask::StartNFCTag()
{
	// Get QR Code and emulate its content using NFC tag
	uint32_t setupPinCode;
	std::string QRCode;

	int result = GetQRCode(setupPinCode, QRCode, chip::RendezvousInformationFlags::kBLE);

	VerifyOrExit(!result, ChipLogError(AppServer, "Getting QR code payload failed"));

	result = sNFC.StartTagEmulation(QRCode.c_str(), QRCode.size());
	VerifyOrExit(result >= 0, ChipLogError(AppServer, "Starting NFC Tag emulation failed"));

exit:
	return result;
}

void AppTask::ThreadProvisioningHandler(const ChipDeviceEvent *event, intptr_t arg)
{
	ARG_UNUSED(arg);
	if ((event->Type == DeviceEventType::kServiceProvisioningChange) && ConnectivityMgr().IsThreadProvisioned()) {
		const int result = sNFC.StopTagEmulation();
		if (result) {
			LOG_ERR("Stopping NFC Tag emulation failed");
		}
	}
}
#endif

void AppTask::ButtonEventHandler(uint32_t button_state, uint32_t has_changed)
{
	if (DK_BTN1_MSK & button_state & has_changed) {
		GetAppTask().PostEvent(AppEvent{ AppEvent::FactoryReset });
	}

	if (DK_BTN2_MSK & button_state & has_changed) {
		GetAppTask().PostEvent(AppEvent{ AppEvent::Toggle, false });
	}

	if (DK_BTN3_MSK & button_state & has_changed) {
		GetAppTask().PostEvent(AppEvent{ AppEvent::StartThread });
	}

	if (DK_BTN4_MSK & button_state & has_changed) {
		GetAppTask().PostEvent(AppEvent{ AppEvent::StartBleAdvertising });
	}
}
```

## src/AppTask.h
```c
/*
 * Copyright (c) 2020 Nordic Semiconductor ASA
 *
 * SPDX-License-Identifier: LicenseRef-BSD-5-Clause-Nordic
 */

#pragma once

#include "AppEvent.h"
#include "BoltLockManager.h"

#include <platform/CHIPDeviceLayer.h>

struct k_timer;

class AppTask {
public:
	int StartApp();

	void PostEvent(const AppEvent &aEvent);
	void UpdateClusterState();

private:
	int Init();

	void DispatchEvent(const AppEvent &event);
	void LockActionHandler(BoltLockManager::Action action, bool chipInitiated);
	void CompleteLockActionHandler();
	void StartThreadHandler();
	void StartBLEAdvertisingHandler();

#ifdef CONFIG_CHIP_NFC_COMMISSIONING
	int StartNFCTag();
#endif

	static void ButtonEventHandler(uint32_t buttons_state, uint32_t has_changed);
	static void ThreadProvisioningHandler(const chip::DeviceLayer::ChipDeviceEvent *event, intptr_t arg);

	friend AppTask &GetAppTask();

	static AppTask sAppTask;
};

inline AppTask &GetAppTask()
{
	return AppTask::sAppTask;
}
```

## src/BoltLockManager.cpp
```c
/*
 * Copyright (c) 2020 Nordic Semiconductor ASA
 *
 * SPDX-License-Identifier: LicenseRef-BSD-5-Clause-Nordic
 */

#include "BoltLockManager.h"

#include "AppTask.h"

#include <logging/log.h>
#include <zephyr.h>

LOG_MODULE_DECLARE(app);

static k_timer sLockTimer;

BoltLockManager BoltLockManager::sLock;

void BoltLockManager::Init()
{
	k_timer_init(&sLockTimer, &BoltLockManager::ActuatorTimerHandler, nullptr);
	k_timer_user_data_set(&sLockTimer, this);

	mState = State::LockingCompleted;
	mChipInitiatedAction = false;
}

bool BoltLockManager::IsActionInProgress()
{
	return mState == State::LockingInitiated || mState == State::UnlockingInitiated;
}

bool BoltLockManager::IsUnlocked()
{
	return mState == State::UnlockingCompleted;
}

bool BoltLockManager::InitiateAction(Action action, bool chipInitiated)
{
	// Initiate Lock/Unlock Action only when the previous one is complete.
	switch (action) {
	case Action::Lock:
		if (mState != State::UnlockingCompleted) {
			return false;
		}
		LOG_INF("Lock Action has been initiated");
		mState = State::LockingInitiated;
		break;
	case Action::Unlock:
		if (mState != State::LockingCompleted) {
			return false;
		}
		LOG_INF("Unlock Action has been initiated");
		mState = State::UnlockingInitiated;
		break;
	default:
		return false;
	}

	mChipInitiatedAction = chipInitiated;
	StartTimer(kActuatorMovementPeriodMs);
	return true;
}

bool BoltLockManager::CompleteCurrentAction(bool &chipInitiated)
{
	switch (mState) {
	case State::LockingInitiated:
		LOG_INF("Lock Action has been completed");
		mState = State::LockingCompleted;
		chipInitiated = mChipInitiatedAction;
		return true;
	case State::UnlockingInitiated:
		LOG_INF("Unlock Action has been completed");
		mState = State::UnlockingCompleted;
		chipInitiated = mChipInitiatedAction;
		return true;
	default:
		return false;
	}
}

void BoltLockManager::StartTimer(uint32_t aTimeoutMs)
{
	k_timer_start(&sLockTimer, K_MSEC(aTimeoutMs), K_NO_WAIT);
}

void BoltLockManager::CancelTimer()
{
	k_timer_stop(&sLockTimer);
}

void BoltLockManager::ActuatorTimerHandler(k_timer *timer)
{
	GetAppTask().PostEvent(AppEvent{ AppEvent::CompleteLockAction, false });
}
```

## src/BoltLockManager.h
```c
/*
 * Copyright (c) 2020 Nordic Semiconductor ASA
 *
 * SPDX-License-Identifier: LicenseRef-BSD-5-Clause-Nordic
 */

#pragma once

#include <cstdint>

#include "AppEvent.h"

struct k_timer;

class BoltLockManager {
public:
	enum class Action : uint8_t { Lock, Unlock };

	void Init();

	bool IsUnlocked();
	bool IsActionInProgress();

	bool InitiateAction(Action action, bool chipInitiated);
	bool CompleteCurrentAction(bool &chipInitiated);

private:
	enum class State : uint8_t { LockingInitiated = 0, LockingCompleted, UnlockingInitiated, UnlockingCompleted };

	static constexpr uint32_t kActuatorMovementPeriodMs = 2000;

	void StartTimer(uint32_t aTimeoutMs);
	void CancelTimer();

	static void ActuatorTimerHandler(k_timer *timer);

	friend BoltLockManager &BoltLockMgr();

	State mState;
	bool mChipInitiatedAction;

	static BoltLockManager sLock;
};

inline BoltLockManager &BoltLockMgr()
{
	return BoltLockManager::sLock;
}
```

## src/CHIPProjectConfig.h
```c
/*
 * Copyright (c) 2020 Nordic Semiconductor ASA
 *
 * SPDX-License-Identifier: LicenseRef-BSD-5-Clause-Nordic
 */

/**
 *    @file
 *          Example project configuration file for CHIP.
 *
 *          This is a place to put application or project-specific overrides
 *          to the default configuration values for general CHIP features.
 *
 */

#pragma once

// Use a default pairing code if one hasn't been provisioned in flash.
#define CHIP_DEVICE_CONFIG_USE_TEST_SETUP_PIN_CODE 12345678
#define CHIP_DEVICE_CONFIG_USE_TEST_SETUP_DISCRIMINATOR 0xF00
```
